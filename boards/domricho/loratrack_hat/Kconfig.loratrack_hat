## boards/domricho/loratrack_hat/board.yml
```yaml
board:
  name: loratrack_hat
  full_name: LoRa Track HAT
  vendor: domricho
  socs:
    - name: stm32h7b0xx
```

## drivers/gnss/Kconfig
```kconfig
# Copyright (c) 2024 Nordic Semiconductor ASA
# SPDX-License-Identifier: Apache-2.0

menuconfig GNSS
	bool "GNSS Drivers"
	help
	  This option enables the GNSS custom driver class.

if GNSS

config GNSS_INIT_PRIORITY
	int "Blink device drivers init priority"
	default KERNEL_INIT_PRIORITY_DEVICE
	help
	  GNSS device drivers init priority.

module = GNSS
module-str = gnss
source "subsys/logging/Kconfig.template.log_config"

rsource "Kconfig.liv3fl"

endif # GNSS
```

## drivers/gnss/Kconfig.liv3fl
```kconfig
# Copyright (c) 2024 Nordic Semiconductor ASA
# SPDX-License-Identifier: Apache-2.0

config LIV3FL
	bool "ST Teseo-LIV3FL GNSS module"
	default y
	depends on GNSS
	depends on DT_HAS_ST_LIV3FL_ENABLED
	depends on GNSS_REFERENCE_FRAME_WGS84
	select MODEM_MODULES
	select MODEM_BACKEND_UART
	select MODEM_CHAT
    select GNSS_ST_PROTO
	help
        ST Teseo-Liv3fl GNSS module

if LIV3FL

config GNSS_LIV3FL_SATELLITES_COUNT
	int "Maximum satellite count"
	depends on GNSS_SATELLITES
	default 24
	help
	  Maximum number of satellite that the driver that can be decoded from
	  the GNSS device. This does not affect the number of devices that the
	  device is actually tracking, just how many of those can be reported
	  in the satellites callback.

endif
```

## drivers/sensor/Kconfig
```kconfig
# Copyright (c) 2021 Nordic Semiconductor ASA
# SPDX-License-Identifier: Apache-2.0

if SENSOR
rsource "sen0546/Kconfig"
endif # SENSOR
```

## drivers/sensor/sen0546/Kconfig
```kconfig
# Copyright (c) 2021 Nordic Semiconductor ASA
# SPDX-License-Identifier: Apache-2.0

config SEN0546
	bool "sen0546 Temp/Humi Sensor"
	default y
	depends on DT_HAS_SEN0546_ENABLED
	help
	  I2C digital temperature & humidity sensor
```

## drivers/timer/Kconfig
```kconfig
menuconfig TIMERS
	bool "TIMERS Drivers"
	help
	  This option enables the TIMERS custom driver class.

if TIMERS

config TIMERS_INIT_PRIORITY
	int "Blink device drivers init priority"
	default KERNEL_INIT_PRIORITY_DEVICE
	help
	  TIMERS device drivers init priority.

module = TIMERS
module-str = timers
source "subsys/logging/Kconfig.template.log_config"

rsource "Kconfig.liv3fl"

endif # TIMERS
```

## drivers/timer/Kconfig.timers
```kconfig
config TIMERS_INPUT_CAPTURE
    bool "STM32 Timer input capture"
    default y
    depends on COUNTER
    select USE_STM32_HAL_TIM
```

## dts/bindings/gnss/st,liv3fl.yaml
```yaml
# Copyright 2023 Google LLC
# SPDX-License-Identifier: Apache-2.0

compatible: "st,liv3fl"

description: |
  ST Teseo-LIV3FL Binding

include: [gnss-nmea-generic.yaml]

properties:
  reset-gpios:
    type: phandle-array
    required: true
    description: Reset GPIO
  # pps-gpios:
  #   type: phandle-array
  #   required: false
    description: Pulse Per Second GPIO
  initial-baudrate:
    type: int
    default: 9600
    enum: [4800, 9600, 19200, 38400, 57600, 115200, 230400, 460800]
  fix-rate:
    type: int
    default: 1000
```

## dts/bindings/sensor/sen0546.yaml
```yaml
# Copyright (c) 2021 Nordic Semiconductor ASA
# SPDX-License-Identifier: Apache-2.0

description: |
  i2c temp/humi sensor

compatible: "sen0546"

include: [sensor-device.yaml, i2c-device.yaml]
```

## lib/gnss/Kconfig
```kconfig
config GNSS_ST_PROTO
	bool "Support for LIV3FL Driver"
	help
	  Support for LIV3FL driver
```

## lib/lora/Kconfig
```kconfig
# Copyright (c) 2021 Legrand North America, LLC.
# SPDX-License-Identifier: Apache-2.0

config LORA_SUPPORT
	bool "LoRa Support"
	help
	  Support for LoRa driver
```
